## main/Kconfig.projbuild
```kconfig
# put here your custom config value
menu "Tinycar Configuration"
    config ESP_WIFI_SSID
        string "WiFi SSID"
        default "myssid"
        help
        SSID (network name) for the Tinycar to connect to.

    config ESP_WIFI_PASSWORD
        string "WiFi Password"
        default "mypassword"
        help
        WiFi password (WPA or WPA2) for the Tinycar to use.

    config ESP_HOSTNAME
        string "Hostname"
        default "Tinycar01"
        help
        Hostname for the Tinycar.

    config UDP_PORT
        int "Port"
        range 0 65535
        default 55002
        help
        Port for the Tinycar to listen on.

    ###########################################################
    # CAMERA
    config CAMERA_ENABLED
        bool "Use camera"
        default n
        help
        Set this to true if car has a camera.

    config CAMERA_RX_PORT
        depends on CAMERA_ENABLED
        int "Camera Frame Receive Port"
        range 0 65535
        default 55003
        help
        To this port the camera frames are being sent over UDP

    ###########################################################
    # BATTERY MEASUREMENT
    config BATTERY_MEASUREMENT
        bool "Use battery voltage measurement"
        default y
        help
        Set this to true if you want to activate the battery voltage measurement.

    ###########################################################
    # SERVO CONTROL
    config SERVO_CONTROL
        bool "Use servo control"
        default n
        help
        Set this to true if car has a servo.

    config SERVO_MAX_STEERING_ANGLE
        depends on SERVO_CONTROL
        int "Servo max steering angle"
        range 0 40
        default 25
        help
        Max angle for the steering (in degrees).
    
    ###########################################################
    # LIGHT CONTROL

    config LIGHT_CONTROL
        bool "Use light control"
        default y
        help
        Set this to true if car has lights, which can be controlled.

    config BLINKER_INTERVAL
        depends on LIGHT_CONTROL
        int "Blinker interval"
        range 0 1000
        default 500
        help
        Interval for the blinkers (in ms).

    ###########################################################
    # MOTOR CONTROL
    config MOTOR_PWM_FREQ
        int "Motor PWM frequency"
        range 0 50000
        default 50000
        help
        PWM frequency for the motor (in Hz).

    config MOTOR_INVERT_DIR
        bool "Motor invert direction"
        default n
        help
        Invert the motor direction.

    config MOTOR_MAX_DUTY_CYCLE
        int "Motor max duty cycle"
        range 0 100
        default 100
        help
        Max PWM duty cycle for the motor (in %). This helps preventing the motor from overheating.
    
endmenu
```
